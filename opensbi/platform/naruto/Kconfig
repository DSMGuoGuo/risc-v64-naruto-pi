## opensbi/platform/naruto/Kconfig
```kconfig
#@file objects.mk
#@author JihongZhang (1042476967@qq.com)
#@brief Naruto Pi Opensbi.
#@version 0.1
#@date 2024-05-07
#
#@copyright Copyright (c) 2024

config PLATFORM_NARUTO
	bool
	select FDT
	select FDT_DOMAIN
	select FDT_PMU
	default y
```

## u-boot/board/emulation/qemu-naruto/Kconfig
```kconfig
if TARGET_QEMU_NARUTO_PI

config SYS_BOARD
	default "qemu-naruto"

config SYS_VENDOR
	default "emulation"

config SYS_CPU
	default "generic"

config SYS_CONFIG_NAME
	default "qemu-naruto-pi"

config TEXT_BASE
	default 0xB0200000

config BOARD_SPECIFIC_OPTIONS # dummy
	def_bool y
	select GENERIC_RISCV
	select CMD_QFW
	select QFW_MMIO
	imply SMP
	imply BOARD_LATE_INIT
	imply CMD_POWEROFF
	imply CMD_EXT2
	imply CMD_EXT4
	imply CMD_FAT
	imply CMD_FS_GENERIC
	imply SYS_NS16550
	imply SIFIVE_SERIAL
	imply MACB
	imply SYSRESET
	imply SYSRESET_CMD_POWEROFF
	imply VIRTIO_MMIO
	imply VIRTIO_PCI
	imply VIRTIO_NET
	imply VIRTIO_BLK
endif
```

## u-boot/configs/qemu-naruto_pi_defconfig
```kconfig
CONFIG_RISCV=y
CONFIG_NR_DRAM_BANKS=1
CONFIG_SYS_LOAD_ADDR=0x80000000
CONFIG_STANDALONE_LOAD_ADDR=0x80000000
CONFIG_HAS_CUSTOM_SYS_INIT_SP_ADDR=y
CONFIG_CUSTOM_SYS_INIT_SP_ADDR=0xB0080000
CONFIG_SYS_FLASH_BASE=0x20000000
CONFIG_ENV_SIZE=0x20000
CONFIG_SYS_MALLOC_F_LEN=0x10000
CONFIG_TARGET_QEMU_NARUTO_PI=y
CONFIG_ARCH_RV64I=y
CONFIG_RISCV_SMODE=y
CONFIG_DISTRO_DEFAULTS=y
CONFIG_FIT=y
CONFIG_DISPLAY_CPUINFO=y
CONFIG_DISPLAY_BOARDINFO=y
CONFIG_BOOTSTD=y
CONFIG_BOOTSTD_FULL=y
CONFIG_CMD_BOOTMENU=y
CONFIG_CMD_BOOTEFI_SELFTEST=y
CONFIG_CMD_NVEDIT_EFI=y
CONFIG_CMD_MEMTEST=y
CONFIG_CMD_MTD=y
CONFIG_CMD_MTDPARTS=y
CONFIG_CMD_NET=y
CONFIG_CMD_LINK_LOCAL=y
CONFIG_CMD_DNS=y
CONFIG_CMD_AES=y
CONFIG_CMD_HASH=y
CONFIG_CMD_MD5SUM=y
CONFIG_CMD_EXCEPTION=y
CONFIG_CMD_SBI=y
CONFIG_CMD_LICENSE=y
CONFIG_SYS_RELOC_GD_ENV_ADDR=y
```
